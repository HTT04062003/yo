## meta-scara/conf/layer.conf
```bitbake
# We have a conf and classes directory, add to BBPATH
BBPATH .= ":${LAYERDIR}"

# We have recipes-* directories, add to BBFILES
BBFILES += "${LAYERDIR}/recipes-*/*/*.bb \
            ${LAYERDIR}/recipes-*/*/*.bbappend"

BBFILE_COLLECTIONS += "meta-scara"
BBFILE_PATTERN_meta-scara = "^${LAYERDIR}/"
BBFILE_PRIORITY_meta-scara = "6"

LAYERDEPENDS_meta-scara = "core"
LAYERSERIES_COMPAT_meta-scara = "kirkstone"
```
